&i2c0 {
    status = "okay";
    display: ssd1306@3c {
        compatible = "solomon,ssd1306fb";
        reg = <0x3c>;
        width = <128>;
        height = <32>;
        // Optional properties:
        // bus-speed = <400000>; // Common I2C speed
    };
};
